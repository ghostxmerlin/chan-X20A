/* SPDX-License-Identifier: MIT */
#include "../upstream/StackChan/firmware/main/hal/drivers/environment/bmm150_data.h"
#include "../upstream/StackChan/firmware/main/hal/drivers/environment/bmi270_aux.h"
#include "../upstream/StackChan/firmware/main/hal/drivers/environment/ltr553.h"
#include "../upstream/StackChan/firmware/main/hal/drivers/environment/optical_runtime.h"
#include <array>
#include <cassert>
#include <cmath>
#include <cstdio>
#include <cstring>
#include <vector>

using namespace environment;
namespace {
void close(float actual, float expected, float tolerance = 0.002f)
{
    assert(std::isfinite(actual));
    assert(std::fabs(actual - expected) < tolerance);
}
Bmm150Trim reference_trim()
{
    // Register representation deliberately includes negative int8/int16 values
    // and the reserved high bit of XYZ1. This checks decoding, not just math.
    const uint8_t a[]{0xfb, 8};
    const uint8_t b[]{0xdc, 0x05, 0xfd, 0xfa};
    const uint8_t c[]{0x3c, 0xf6, 0x30, 0x75, 0x90, 0xe5, 0x50, 0xfb, 0xfe, 40};
    auto t = bmm150_trim(a, b, c);
    assert(t.valid() && t.x1 == -5 && t.y1 == 8 && t.x2 == -3 && t.y2 == -6);
    assert(t.z1 == 30000 && t.z2 == -2500 && t.z3 == -1200 && t.z4 == 1500);
    assert(t.xy1 == 40 && t.xy2 == -2 && t.xyz1 == 26000);
    return t;
}
std::array<uint8_t, 8> magnetic_bytes(int16_t x, int16_t y, int16_t z, uint16_t hall, bool ready = true)
{
    const uint16_t packed_x = uint16_t(x) << 3, packed_y = uint16_t(y) << 3;
    const uint16_t packed_z = uint16_t(z) << 1, packed_h = hall << 2;
    return {uint8_t(packed_x), uint8_t(packed_x >> 8), uint8_t(packed_y), uint8_t(packed_y >> 8),
        uint8_t(packed_z), uint8_t(packed_z >> 8), uint8_t(packed_h | (ready ? 1 : 0)), uint8_t(packed_h >> 8)};
}
void magnetic_tests()
{
    const auto trim = reference_trim();
    // Golden results generated by compiling the unmodified official Bosch
    // BMM150 SensorAPI v2.0.0 floating-point compensate_x/y/z functions.
    // bmm150.c SHA256: 477270b71a7c7b47acf47a21a7bc0b972bdf8deb021a6597b44b6cf2a3f1e926
    // https://github.com/boschsensortec/BMM150_SensorAPI/blob/master/bmm150.c
    struct Vector { int16_t xyz[3]; uint16_t hall; float ut[3]; };
    const Vector vectors[]{
        {{150, -280, 1200}, 12000, {51.3916931f, -94.6755753f, -103.330910f}},
        {{-1200, 1000, -2800}, 14000, {-417.638184f, 343.338013f, -875.357666f}},
        {{4095, -4095, 16383}, 16383, {1364.98560f, -1337.35547f, 2424.18286f}},
        {{0, 0, 0}, 8000, {-2.5f, 4.0f, -706.746582f}},
    };
    for (const auto& vector : vectors) {
        float actual[3]{};
        assert(bmm150_compensate(trim, vector.xyz, vector.hall, actual));
        for (int i = 0; i < 3; ++i) close(actual[i], vector.ut[i]);
    }
    float value[]{1, 2, 3};
    const int16_t good[]{150, -280, 1200};
    for (int axis = 0; axis < 3; ++axis) {
        int16_t raw[]{150, -280, 1200}; raw[axis] = axis == 2 ? -16384 : -4096;
        assert(!bmm150_compensate(trim, raw, 12000, value));
        assert(value[0] == 1); // no fake zero or partly updated engineering vector
    }
    assert(!bmm150_compensate(trim, good, 0, value));
    assert(!bmm150_compensate(Bmm150Trim{}, good, 12000, value));
    auto zero_divisor = trim; zero_divisor.z1 = 32768; zero_divisor.z2 = -12000;
    assert(!bmm150_compensate(zero_divisor, good, 12000, value));

    MagneticSample sample;
    auto bytes = magnetic_bytes(-1200, 1000, -2800, 14000);
    bmm150_consume(sample, trim, 0x20, bytes.data(), 100);
    assert(!sample.has_raw && sample.seq == 0); // cannot bypass ID/init gate
    sample.available = true;
    bmm150_consume(sample, trim, 0, bytes.data(), 200);
    assert(!sample.has_raw);
    bmm150_consume(sample, trim, 0x20, bytes.data(), 300);
    assert(sample.valid && sample.seq == 1 && sample.timestamp_us == 300);
    assert(sample.raw[0] == -1200 && sample.raw[1] == 1000 && sample.raw[2] == -2800 && sample.rhall == 14000);
    close(sample.field_ut[0], vectors[1].ut[0]);
    bmm150_consume(sample, trim, 0, bytes.data(), 400); // BMI cached DRDY bit in aux alone is insufficient
    assert(sample.seq == 1 && sample.timestamp_us == 300);
    bytes[6] &= ~1;
    bmm150_consume(sample, trim, 0x20, bytes.data(), 500); // new BMI read of old BMM conversion
    assert(sample.seq == 1 && sample.timestamp_us == 300);
    bmm150_consume(sample, trim, 0, bytes.data(), 1000300);
    assert(!sample.valid && sample.error == Error::Stale && sample.timestamp_us == 300);
    bytes = magnetic_bytes(-4096, 1000, -2800, 14000);
    bmm150_consume(sample, trim, 0x20, bytes.data(), 1000400);
    assert(sample.seq == 2 && sample.has_raw && sample.overflow && !sample.valid && sample.error == Error::Overflow);
    bytes = magnetic_bytes(-1200, 1000, -2800, 14000);
    bmm150_consume(sample, trim, 0x20, bytes.data(), 1000500);
    assert(sample.seq == 3 && sample.valid && !sample.overflow && sample.error == Error::None);
    bmm150_consume(sample, trim, 0x20, bytes.data(), 1100500);
    assert(sample.seq == 4); // identical field can still be a fresh hardware sample
}

struct FakeBus {
    std::array<uint8_t, 256> regs{};
    int64_t now = 100000;
    int operations = 0, fail_at = -1, fail_register = -1, mismatch_register = -1, waits = 0;
    std::vector<uint8_t> written;
    FakeBus() { regs[0x86] = 0x92; regs[0x87] = 5; }
    RegisterIo io()
    {
        return {this,
            [](void* opaque, uint8_t reg, uint8_t* out, size_t size) {
                auto& bus = *static_cast<FakeBus*>(opaque);
                if (++bus.operations == bus.fail_at || reg == bus.fail_register) return false;
                assert(size > 0 && reg + size <= bus.regs.size());
                std::memcpy(out, bus.regs.data() + reg, size);
                if (reg == bus.mismatch_register) out[0] ^= 1;
                if (reg == 0x88) { assert(size == 4); bus.regs[0x8c] &= ~4; }
                if (reg == 0x8d) { assert(size == 2); bus.regs[0x8c] &= ~1; }
                bus.now += 100; // timestamp is after the complete read, not poll start
                return true;
            },
            [](void* opaque, uint8_t reg, uint8_t value) {
                auto& bus = *static_cast<FakeBus*>(opaque);
                if (++bus.operations == bus.fail_at || reg == bus.fail_register) return false;
                bus.regs[reg] = value; bus.written.push_back(reg); return true;
            },
            [](void* opaque) { return static_cast<FakeBus*>(opaque)->now; },
            [](void* opaque, uint32_t ms) {
                auto& bus = *static_cast<FakeBus*>(opaque);
                assert(ms == 100); ++bus.waits; bus.now += int64_t(ms) * 1000;
            }};
    }
    void measurement(uint16_t ch0, uint16_t ch1, uint16_t proximity, uint8_t status = 5, bool saturated = false)
    {
        regs[0x88] = uint8_t(ch1); regs[0x89] = uint8_t(ch1 >> 8);
        regs[0x8a] = uint8_t(ch0); regs[0x8b] = uint8_t(ch0 >> 8);
        regs[0x8c] = status;
        regs[0x8d] = uint8_t(proximity); regs[0x8e] = uint8_t(proximity >> 8) | (saturated ? 0x80 : 0);
    }
};
void optical_tests()
{
    float lux = -1;
    assert(ltr553_lux(1000, 100, 1, 100, lux)); close(lux, 1884.89f);
    assert(ltr553_lux(550, 450, 1, 100, lux)); close(lux, 1473.515f);
    assert(ltr553_lux(360, 640, 1, 100, lux)); close(lux, 289.176f);
    assert(ltr553_lux(550, 450, 8, 200, lux)); close(lux, 92.0946875f);
    assert(ltr553_lux(0, 0, 1, 100, lux) && lux == 0);
    assert(!ltr553_lux(150, 850, 1, 100, lux)); // model boundary, never invented darkness
    assert(!ltr553_lux(1, 1, 0, 100, lux));
    assert(!ltr553_lux(1, 1, 1, 0, lux));
    assert(!ltr553_lux(65535, 1, 1, 100, lux));

    FakeBus bus;
    Ltr553 sensor(bus.io());
    assert(sensor.begin());
    const int init_ops = bus.operations;
    assert(sensor.light().available && sensor.proximity().available);
    assert(!sensor.light().has_raw && !sensor.light().valid && sensor.light().seq == 0);
    assert(bus.regs[0x80] == 1 && bus.regs[0x81] == 0x22 && bus.regs[0x85] == 1);
    assert(bus.regs[0x82] == 0x7a && bus.regs[0x83] == 4 && bus.regs[0x84] == 2);
    bus.measurement(1000, 100, 1234);
    sensor.poll();
    assert(sensor.light().valid && sensor.proximity().valid);
    assert(sensor.light().raw_ch0 == 1000 && sensor.light().raw_ch1 == 100 && sensor.light().gain == 1);
    close(sensor.light().lux, 1884.89f);
    assert(sensor.proximity().raw == 1234);
    const auto light_time = sensor.light().timestamp_us, ps_time = sensor.proximity().timestamp_us;
    assert(ps_time > light_time && sensor.light().seq == 1 && sensor.proximity().seq == 1);
    sensor.poll();
    assert(sensor.light().timestamp_us == light_time && sensor.proximity().timestamp_us == ps_time);
    bus.now = ps_time + kFreshUs;
    sensor.poll();
    assert(!sensor.light().valid && sensor.light().error == Error::Stale);
    assert(!sensor.proximity().valid && sensor.proximity().error == Error::Stale);
    assert(sensor.light().seq == 1 && sensor.proximity().seq == 1);

    bus.measurement(1000, 100, 2047, 5, true);
    sensor.poll();
    assert(sensor.light().valid && !sensor.proximity().valid && sensor.proximity().saturated);
    assert(sensor.proximity().raw == 2047 && sensor.proximity().error == Error::Saturated);
    bus.measurement(65535, 100, 20);
    sensor.poll();
    assert(!sensor.light().valid && sensor.light().saturated && sensor.light().error == Error::Saturated);
    assert(sensor.proximity().valid && !sensor.proximity().saturated);
    bus.measurement(1000, 100, 20, 0x85);
    sensor.poll();
    assert(!sensor.light().valid && sensor.light().error == Error::Invalid && !sensor.light().saturated);
    assert(sensor.proximity().valid); // invalid ALS does not suppress independent PS
    bus.measurement(1000, 100, 20, 0x45); // reserved gain
    sensor.poll(); assert(!sensor.light().valid && sensor.light().gain == 0);
    bus.measurement(1000, 100, 20);
    bus.fail_register = 0x88;
    const auto sequence = sensor.light().seq;
    sensor.poll();
    assert(sensor.light().error == Error::I2c && sensor.light().seq == sequence);
    assert(sensor.proximity().valid); // one failed channel read does not poison the other
    bus.fail_register = -1;
    sensor.poll(); assert(sensor.light().valid && sensor.light().seq == sequence + 1);
    bus.fail_register = 0x8c;
    const auto before_fail_time = sensor.light().timestamp_us;
    const auto before_fail_seq = sensor.light().seq;
    const auto before_fail_operations = bus.operations;
    sensor.poll(); assert(sensor.light().error == Error::I2c && sensor.proximity().error == Error::I2c);
    assert(bus.operations == before_fail_operations + 1); // no retry or channel reads after status failure
    assert(sensor.light().seq == before_fail_seq && sensor.light().timestamp_us == before_fail_time);
    assert(!sensor.light().valid && sensor.light().has_raw && sensor.light().raw_ch0 == 1000);

    // Every init transaction failure and a readback mismatch must leave the
    // optional hardware unavailable; poll may not add traffic after failure.
    for (int operation = 1; operation <= init_ops; ++operation) {
        FakeBus broken; broken.fail_at = operation;
        Ltr553 unavailable(broken.io());
        assert(!unavailable.begin());
        assert(!unavailable.light().available && !unavailable.proximity().available);
        assert(unavailable.light().error == Error::I2c);
        const int count = broken.operations;
        unavailable.poll(); assert(broken.operations == count);
    }
    FakeBus mismatch; mismatch.mismatch_register = 0x85;
    Ltr553 bad_config(mismatch.io());
    assert(!bad_config.begin() && bad_config.light().error == Error::Config);
    FakeBus wrong_id; wrong_id.regs[0x86] = 0x91;
    Ltr553 unknown(wrong_id.io());
    assert(!unknown.begin() && unknown.light().chip_id == 0x91 && unknown.light().error == Error::ChipId);
    assert(wrong_id.written.empty()); // never configure an unidentified device
    FakeBus wrong_vendor; wrong_vendor.regs[0x87] = 6;
    Ltr553 unknown_vendor(wrong_vendor.io());
    assert(!unknown_vendor.begin() && unknown_vendor.light().manufacturer_id == 6 && wrong_vendor.written.empty());

    for (int operation = 1; operation <= init_ops; ++operation) {
        FakeBus contention; contention.fail_at = operation;
        Ltr553 recovering(contention.io());
        assert(recovering.initialize());
        assert(recovering.initialization_attempts() == 2 && contention.waits == 1);
        assert(recovering.light().available && !recovering.light().has_raw);
        contention.measurement(1000, 100, 1234);
        recovering.poll();
        assert(recovering.light().valid && recovering.proximity().valid);
        assert(recovering.light().seq == 1); // failed init did not invent a sample
    }
    FakeBus absent; absent.fail_register = 0x86;
    Ltr553 bounded(absent.io());
    assert(!bounded.initialize() && bounded.initialization_attempts() == 3 && absent.waits == 2);
    const int bounded_ops = absent.operations;
    bounded.poll(); assert(absent.operations == bounded_ops);
    FakeBus persistent; persistent.fail_register = 0x80;
    Ltr553 failed_config_io(persistent.io());
    assert(!failed_config_io.initialize() && failed_config_io.initialization_attempts() == 3 && persistent.waits == 2);
    FakeBus wrong; wrong.regs[0x86] = 0x91;
    Ltr553 no_wrong_retry(wrong.io());
    assert(!no_wrong_retry.initialize() && no_wrong_retry.initialization_attempts() == 1 && wrong.waits == 0);
    FakeBus readback; readback.mismatch_register = 0x85;
    Ltr553 no_config_retry(readback.io());
    assert(!no_config_retry.initialize() && no_config_retry.initialization_attempts() == 1 && readback.waits == 0);
}

void optical_runtime_tests()
{
    OpticalRuntimeDiagnostic diagnostic;
    assert(diagnostic.transactions == 0 && diagnostic.errors == 0);
    assert(diagnostic.last_i2c_register == -1 && diagnostic.last_error_timestamp_us == 0);
    assert(diagnostic.observe(0, 0x8c, false, 100));
    assert(diagnostic.last_i2c_register == -1); // successful reads do not invent an error
    assert(!diagnostic.observe(0x107, 0x88, false, 200));
    const auto cached = diagnostic;
    for (int i = 0; i < 20; ++i) assert(diagnostic.observe(0, 0x8d, false, 300 + i));
    assert(diagnostic.transactions == 22 && diagnostic.errors == 1);
    assert(diagnostic.last_i2c_error == 0x107 && diagnostic.last_i2c_register == 0x88);
    assert(!diagnostic.last_i2c_write && diagnostic.last_error_timestamp_us == 200);
    assert(cached.transactions == 2 && cached.last_error_timestamp_us == 200);
    assert(!diagnostic.observe(0x101, 0x80, true, 400));
    assert(diagnostic.errors == 2 && diagnostic.last_i2c_write && diagnostic.last_i2c_register == 0x80);
    assert(diagnostic.last_error_timestamp_us == 400);

    // Model a 100 Hz scheduler. DelayUntil is allowed to return without any
    // blocking after a slow poll; the production policy must yield and reset
    // instead of issuing many stale scheduled polls in a burst.
    uint32_t ticks = 0, wake = 0, blocked = 0;
    auto until = [&](uint32_t* previous, uint32_t period) {
        *previous += period;
        if (*previous <= ticks) return false;
        blocked += *previous - ticks;
        ticks = *previous;
        return true;
    };
    auto delay = [&](uint32_t amount) { assert(amount >= 1); ticks += amount; blocked += amount; };
    auto now = [&] { return ticks; };
    wait_for_optical_poll(wake, uint32_t{10}, until, delay, now);
    assert(ticks == 10 && wake == 10);
    ticks += 35; // failed/shared-bus I/O consumed 350 ms
    const auto blocked_before = blocked;
    wait_for_optical_poll(wake, uint32_t{10}, until, delay, now);
    assert(ticks == 46 && wake == 46 && blocked == blocked_before + 1);
    wait_for_optical_poll(wake, uint32_t{10}, until, delay, now);
    assert(ticks == 56 && wake == 56); // no catch-up to old 20/30/40-tick deadlines
    for (unsigned i = 0; i < 50; ++i) {
        ticks += 20; // persistent delayed failures still block every iteration
        const auto before = ticks, previous_blocked = blocked;
        wait_for_optical_poll(wake, uint32_t{10}, until, delay, now);
        assert(ticks > before && blocked > previous_blocked && wake == ticks);
    }
}

void bounded_aux_tests()
{
    uint8_t result[10]{};
    int operations = 0, fail_at = -1, waits = 0;
    bool busy = false;
    uint8_t address = 0;
    auto read = [&](uint8_t reg, uint8_t* data, size_t size) {
        if (++operations == fail_at) return false;
        if (reg == 3) { assert(size == 1); data[0] = busy ? 4 : 0; }
        else {
            assert(reg == 4 && size == 8);
            for (size_t i = 0; i < size; ++i) data[i] = uint8_t(address + i);
        }
        return true;
    };
    auto write = [&](uint8_t reg, uint8_t value) {
        if (++operations == fail_at) return false;
        assert(reg == 0x4d); address = value; return true;
    };
    auto wait = [&]() { ++waits; };
    assert(bmi270_read_aux(0x68, result, sizeof(result), read, write, wait));
    for (size_t i = 0; i < sizeof(result); ++i) assert(result[i] == 0x68 + i);
    const int full_count = operations;
    for (int failure = 1; failure <= full_count; ++failure) {
        operations = 0; fail_at = failure;
        assert(!bmi270_read_aux(0x68, result, sizeof(result), read, write, wait));
        assert(operations == failure); // no loop on zero read_length / failed transaction
    }
    operations = waits = 0; fail_at = -1; busy = true;
    assert(!bmi270_read_aux(0x68, result, sizeof(result), read, write, wait));
    assert(operations == 8 && waits == 8); // busy hardware is bounded too
}
} // namespace
int main()
{
    magnetic_tests(); optical_tests(); optical_runtime_tests(); bounded_aux_tests();
    std::puts("Environment sensors: compensation, freshness, LTR553 failures, runtime diagnostics and bounded cadence passed");
}
